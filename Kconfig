## Kconfig
```kconfig
menu "RT-Thread  App config"


config RTT_APP_DIR
    string
    default "../../../../../"

menu "Main"
source "$RTT_APP_DIR/src/Kconfig"
endmenu

menu "Lib"
source "$RTT_APP_DIR/lib/Kconfig"
endmenu


endmenu
```

## lib/Kconfig
```kconfig
config APP_USING_PAHOMQTT
    bool "using pahomqtt"
    default y
    select PKG_USING_PAHOMQTT
    select PKG_USING_PAHOMQTT_LATEST

if APP_USING_PAHOMQTT

config PKG_PAHOMQTT_VER
    string
    default "latest"
     
endif
```

## src/Kconfig
```kconfig
config APP_AUTORESET_ON_ERROR
    bool "autoreset on error"
    default y

if  APP_USING_PAHOMQTT

choice APP_MQTT_PROTOCOL
    prompt "MQTT Protocol"
    default APP_MQTT_PROTOCOL_HELLO

config APP_MQTT_PROTOCOL_HELLO
    bool "hello"
    

endchoice

config APP_MQTT_URI
    string "MQTT Uri"
    default "tcp://mqtt.hyhsystem.cn:1883"

endif
```
